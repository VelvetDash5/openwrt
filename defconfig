## defconfig
```kconfig
CONFIG_TARGET_ipq40xx=y
CONFIG_TARGET_ipq40xx_generic=y
CONFIG_TARGET_ipq40xx_generic_DEVICE_netgear_rbr50-v2=y
CONFIG_TARGET_ROOTFS_SQUASHFS=y
# CONFIG_TARGET_ALL_PROFILES is not set
# CONFIG_TARGET_MULTI_PROFILE is not set
CONFIG_DEVEL=y
CONFIG_CCACHE=y
# Disable Candela Technologies (CT) packages
# CONFIG_PACKAGE_kmod-ath10k-ct is not set
# CONFIG_PACKAGE_ath10k-firmware-qca9984-ct is not set

# Enable Standard ath10k Driver & Firmware
CONFIG_PACKAGE_kmod-ath10k=y
CONFIG_PACKAGE_kmod-ath10k-pci=y
CONFIG_PACKAGE_ath10k-firmware-qca9984=y
```
